/*
 * ssd1315.c
 *
 *  Created on: Jun 24, 2026
 *      Author: joki
 */


#include "LCD/ssd1315.h"
#include <string.h>
#include <stdio.h>


// Screen local buffer (128 * 64 / 8 = 1024 bytes)
static uint8_t SSD1315_Buffer[SSD1315_WIDTH * SSD1315_HEIGHT / 8];

static void SSD1315_WriteCommand(I2C_HandleTypeDef *hi2c, uint8_t byte) {
	HAL_I2C_Mem_Write(hi2c, SSD1315_I2C_ADDR, 0x00, 1, &byte, 1, HAL_MAX_DELAY);
}

uint8_t SSD1315_Init(I2C_HandleTypeDef *hi2c) {
	HAL_Delay(100);

	SSD1315_WriteCommand(hi2c, 0xAE); // Turn display off
	SSD1315_WriteCommand(hi2c, 0xD5); // Set display clock divide ratio/oscillator frequency
	SSD1315_WriteCommand(hi2c, 0x80);
	SSD1315_WriteCommand(hi2c, 0xA8); // Set multiplex ratio
	SSD1315_WriteCommand(hi2c, SSD1315_HEIGHT - 1);
	SSD1315_WriteCommand(hi2c, 0xD3); // Set display offset
	SSD1315_WriteCommand(hi2c, 0x00);
	SSD1315_WriteCommand(hi2c, 0x40); // Set display start line
	SSD1315_WriteCommand(hi2c, 0x8D); // Charge pump command
	SSD1315_WriteCommand(hi2c, 0x14); // Enable charge pump
	SSD1315_WriteCommand(hi2c, 0x20); // Set memory addressing mode
	SSD1315_WriteCommand(hi2c, 0x00); // Horizontal addressing mode
	SSD1315_WriteCommand(hi2c, 0xA1); // Set segment re-map (Column 127 is mapped to SEG0)
	SSD1315_WriteCommand(hi2c, 0xC8); // Set COM Output Scan Direction
	SSD1315_WriteCommand(hi2c, 0xDA); // Set COM pins hardware configuration
	SSD1315_WriteCommand(hi2c, 0x12);
	SSD1315_WriteCommand(hi2c, 0x81); // Set contrast control
	SSD1315_WriteCommand(hi2c, 0xCF);
	SSD1315_WriteCommand(hi2c, 0xD9); // Set pre-charge period
	SSD1315_WriteCommand(hi2c, 0xF1);
	SSD1315_WriteCommand(hi2c, 0xDB); // Set VCOMH deselect level
	SSD1315_WriteCommand(hi2c, 0x40);
	SSD1315_WriteCommand(hi2c, 0xA4); // Entire display on (Resume to RAM content)
	SSD1315_WriteCommand(hi2c, 0xA6); // Set normal display (not inverted)
	SSD1315_WriteCommand(hi2c, 0xAF); // Turn display on

	SSD1315_Clear();
	SSD1315_UpdateScreen(hi2c);

	return 1; // Success
}

// Clear the screen buffer
void SSD1315_Clear(void) {
	memset(SSD1315_Buffer, 0x00, sizeof(SSD1315_Buffer));
}

// Push the buffer data to the actual display
void SSD1315_UpdateScreen(I2C_HandleTypeDef *hi2c) {
	for (uint8_t i = 0; i < 8; i++) {
		SSD1315_WriteCommand(hi2c, 0xB0 + i);   // Set page address
		SSD1315_WriteCommand(hi2c, 0x00);       // Set low column address
		SSD1315_WriteCommand(hi2c, 0x10);       // Set high column address

		// Write a page of data (128 bytes)
		HAL_I2C_Mem_Write(hi2c, SSD1315_I2C_ADDR, 0x40, 1, &SSD1315_Buffer[SSD1315_WIDTH * i], SSD1315_WIDTH, HAL_MAX_DELAY);
	}
}

// Draw a single pixel to the buffer (color: 1 = White, 0 = Black)
void SSD1315_DrawPixel(uint8_t x, uint8_t y, uint8_t color) {
	if (x >= SSD1315_WIDTH || y >= SSD1315_HEIGHT) return;

	if (color) {
		SSD1315_Buffer[x + (y / 8) * SSD1315_WIDTH] |= (1 << (y % 8));
	} else {
		SSD1315_Buffer[x + (y / 8) * SSD1315_WIDTH] &= ~(1 << (y % 8));
	}
}

void SSD1315_DrawBorder(int startX, int endX, int startY, int endY, I2C_HandleTypeDef* handle)
{
	for(int i = startY; i < endY; i++)
	{
		SSD1315_DrawPixel(startX, i, 1);
		SSD1315_DrawPixel(endX, i, 1);
	}
	for(int i = startX; i < endX; i++)
	{
		SSD1315_DrawPixel(i, startY, 1);
		SSD1315_DrawPixel(i, endY, 1);
	}
	SSD1315_UpdateScreen(handle);
}

// Standard 5x7 ASCII Font (Characters 32 to 126)
// Complete 5x7 ASCII Font (Characters 32 [Space] to 126 [~])
static const uint8_t Font5x7[][5] = {
		{0x00, 0x00, 0x00, 0x00, 0x00}, // Space (32)
		{0x00, 0x00, 0x4F, 0x00, 0x00}, // !
		{0x00, 0x07, 0x00, 0x07, 0x00}, // "
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		{0x10, 0x08, 0x18, 0x10, 0x08}  // ~
};

void SSD1315_DrawChar(uint8_t x, uint8_t y, char c) {
	// Force character to be completely unsigned so its value stays strictly 0-255
	uint8_t ascii_idx = (uint8_t)c;

	// Safety boundaries: Standard printable ASCII ranges from 32 (Space) to 126 (~)
	if (ascii_idx < 32 || ascii_idx > 126) {
		ascii_idx = 32;
	}

	uint8_t font_row = ascii_idx - 32;

	for (uint8_t i = 0; i < 5; i++) {
		uint8_t line = Font5x7[font_row][i];
		for (uint8_t j = 0; j < 8; j++) {
			if (line & (1 << j)) {
				SSD1315_DrawPixel(x + i, y + j, 1);
			} else {
				SSD1315_DrawPixel(x + i, y + j, 0);
			}
		}
	}
}

void SSD1315_DrawString(uint8_t x, uint8_t y, const char* str) {
	while (*str) {
		SSD1315_DrawChar(x, y, *str++);
		x += 6;
		if (x > 122) break;
	}
}
void SSD1315_Title(const char* str)
{
	SSD1315_DrawString(10, 2, str);
}
void SSD1315_Line_1(const char* str)
{
	SSD1315_DrawString(10, 20, str);
}
void SSD1315_Line_2(const char* str)
{
	SSD1315_DrawString(10, 36, str);
}
void SSD1315_Line_3(const char* str)
{
	SSD1315_DrawString(10, 54, str);
}
