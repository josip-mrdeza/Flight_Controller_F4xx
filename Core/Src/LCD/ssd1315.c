#include "LCD/ssd1315.h"
#include "Drivers/i2c_helper.h"
#include <string.h>
#include <stdio.h>

static uint8_t SSD1315_Buffer[SSD1315_WIDTH * SSD1315_HEIGHT / 8];

static void SSD1315_WriteCommand(I2C_HandleTypeDef *hi2c, uint8_t byte) {
	I2C_Mem_Write_DMA(hi2c, SSD1315_I2C_ADDR, 0x00, 1, &byte, 1, 100);
}

HAL_StatusTypeDef SSD1315_Init(I2C_HandleTypeDef *hi2c) {
	if (hi2c == NULL) {
		return HAL_ERROR;
	}
	HAL_Delay(100);

	if (HAL_I2C_IsDeviceReady(hi2c, SSD1315_I2C_ADDR, 2, 50) != HAL_OK) {
		return HAL_ERROR;
	}

	SSD1315_WriteCommand(hi2c, 0xAE);
	SSD1315_WriteCommand(hi2c, 0xD5);
	SSD1315_WriteCommand(hi2c, 0x80);
	SSD1315_WriteCommand(hi2c, 0xA8);
	SSD1315_WriteCommand(hi2c, SSD1315_HEIGHT - 1);
	SSD1315_WriteCommand(hi2c, 0xD3);
	SSD1315_WriteCommand(hi2c, 0x00);
	SSD1315_WriteCommand(hi2c, 0x40);
	SSD1315_WriteCommand(hi2c, 0x8D);
	SSD1315_WriteCommand(hi2c, 0x14);
	SSD1315_WriteCommand(hi2c, 0x20);
	SSD1315_WriteCommand(hi2c, 0x00);
	SSD1315_WriteCommand(hi2c, 0xA1);
	SSD1315_WriteCommand(hi2c, 0xC8);
	SSD1315_WriteCommand(hi2c, 0xDA);
	SSD1315_WriteCommand(hi2c, 0x12);
	SSD1315_WriteCommand(hi2c, 0x81);
	SSD1315_WriteCommand(hi2c, 0xCF);
	SSD1315_WriteCommand(hi2c, 0xD9);
	SSD1315_WriteCommand(hi2c, 0xF1);
	SSD1315_WriteCommand(hi2c, 0xDB);
	SSD1315_WriteCommand(hi2c, 0x40);
	SSD1315_WriteCommand(hi2c, 0xA4);
	SSD1315_WriteCommand(hi2c, 0xA6);
	SSD1315_WriteCommand(hi2c, 0xAF);

	SSD1315_Clear();
	SSD1315_Line_1("Initializing...");
	SSD1315_UpdateScreen(hi2c);

	return HAL_OK;
}

void SSD1315_Clear(void) {
	memset(SSD1315_Buffer, 0x00, sizeof(SSD1315_Buffer));
}

void SSD1315_UpdateScreen(I2C_HandleTypeDef *hi2c) {
	for (uint8_t i = 0; i < 8; i++) {
		SSD1315_WriteCommand(hi2c, 0xB0 + i);
		SSD1315_WriteCommand(hi2c, 0x00);
		SSD1315_WriteCommand(hi2c, 0x10);

		I2C_Mem_Write_DMA(hi2c, SSD1315_I2C_ADDR, 0x40, 1, &SSD1315_Buffer[SSD1315_WIDTH * i], SSD1315_WIDTH, 100);
	}
}

void SSD1315_DrawPixel(uint8_t x, uint8_t y, uint8_t color) {
	if (x >= SSD1315_WIDTH || y >= SSD1315_HEIGHT) return;

	if (color) {
		SSD1315_Buffer[x + (y / 8) * SSD1315_WIDTH] |= (1 << (y % 8));
	} else {
		SSD1315_Buffer[x + (y / 8) * SSD1315_WIDTH] &= ~(1 << (y % 8));
	}
}

void SSD1315_DrawBorder(int startX, int endX, int startY, int endY, I2C_HandleTypeDef* handle)
{
	for(int i = startY; i < endY; i++)
	{
		SSD1315_DrawPixel(startX, i, 1);
		SSD1315_DrawPixel(endX, i, 1);
	}
	for(int i = startX; i < endX; i++)
	{
		SSD1315_DrawPixel(i, startY, 1);
		SSD1315_DrawPixel(i, endY, 1);
	}
	SSD1315_UpdateScreen(handle);
}

static const uint8_t Font5x7[][5] = {
		{0x00, 0x00, 0x00, 0x00, 0x00},
		{0x00, 0x00, 0x4F, 0x00, 0x00},
		{0x00, 0x07, 0x00, 0x07, 0x00},
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		{0x10, 0x08, 0x18, 0x10, 0x08}
};

void SSD1315_DrawChar(uint8_t x, uint8_t y, char c) {
	uint8_t ascii_idx = (uint8_t)c;

	if (ascii_idx < 32 || ascii_idx > 126) {
		ascii_idx = 32;
	}

	uint8_t font_row = ascii_idx - 32;

	for (uint8_t i = 0; i < 5; i++) {
		uint8_t line = Font5x7[font_row][i];
		for (uint8_t j = 0; j < 8; j++) {
			if (line & (1 << j)) {
				SSD1315_DrawPixel(x + i, y + j, 1);
			} else {
				SSD1315_DrawPixel(x + i, y + j, 0);
			}
		}
	}
}

void SSD1315_DrawString(uint8_t x, uint8_t y, const char* str) {
	while (*str) {
		SSD1315_DrawChar(x, y, *str++);
		x += 6;
		if (x > 122) break;
	}
}

void SSD1315_Title(const char* str)
{
	SSD1315_DrawString(10, 2, str);
}

void SSD1315_Line_1(const char* str)
{
	SSD1315_DrawString(10, 20, str);
}

void SSD1315_Line_2(const char* str)
{
	SSD1315_DrawString(10, 36, str);
}

void SSD1315_Line_3(const char* str)
{
	SSD1315_DrawString(10, 54, str);
}
